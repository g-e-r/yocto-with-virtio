## meta-virtio-py/conf/layer.conf
```bitbake
BBPATH .= ":${LAYERDIR}"
BBFILES += "${LAYERDIR}/recipes-*/*/*.bb \
            ${LAYERDIR}/recipes-*/*/*.bbappend"
BBFILE_COLLECTIONS += "virtio-py"
BBFILE_PATTERN_virtio-py = "^${LAYERDIR}/"
BBFILE_PRIORITY_virtio-py = "6"
LAYERSERIES_COMPAT_virtio-py = "whinlatter"
PREFERRED_VERSION_linux-yocto = "6.16%"

KERNEL_FEATURES:append = " cfg/virtio.scc"
KERNEL_MODULE_AUTOLOAD:append = " virtio virtio_ring virtio_pci virtio_console i2c-virtio spi-virtio gpio-virtio"

# これを local.conf に書けば、依存関係の元から断てます
# このリポではlocal.confは自動生成してしまっているため一旦layer.confで削除
DISTRO_FEATURES:remove = " bluetooth nfc pcmcia 3g"
MACHINE_FEATURES:remove = " bluetooth"
```
